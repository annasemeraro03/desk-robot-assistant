#include "MoodTask.h"

#include <Arduino.h>

#include "../../app/Robot.h"
#include "../../app/RobotEvents.h"
#include "../../app/RobotState.h"

/**
 * @brief FreeRTOS task responsible for robot mood management.
 *
 * The task continuously waits for events generated by the other
 * FreeRTOS tasks. According to the received event, it updates
 * the robot emotional state and operating mode.
 *
 * Future versions will also manage the attention level, energy
 * consumption, boredom timer and focus mode transitions.
 *
 * @param pvParameters Task parameters (unused).
 */
void moodTask(void *pvParameters){
    RobotEvent event;

    for(;;){
        if(xQueueReceive(robotEventQueue, &event, portMAX_DELAY) == pdPASS){
            switch(event.type){

                case EVENT_TOUCH: {

                    switch(event.id){

                        case TOUCH_EVENT_SINGLE: {
                            robotState.mood = MOOD_HAPPY;
                            robotState.movement = MOVEMENT_STOP;

                            break;
                        }

                        case TOUCH_EVENT_DOUBLE: {
                            robotState.mode = MODE_FOCUS;
                            robotState.mood = MOOD_FOCUS;
                            robotState.movement = MOVEMENT_STOP;

                            break;
                        }

                        case TOUCH_EVENT_LONG: {
                            robotState.currentPage = static_cast<UIPage>((robotState.currentPage + 1) % 3);
                            robotState.movement = MOVEMENT_STOP;

                            break;
                        }
                    }

                    break;
                }

                case EVENT_MOTION: {
                    
                    switch(event.id){

                        case MOTION_EVENT_EDGE_DETECTED:{
                            robotState.mood = MOOD_SURPRISED;
                            robotState.movement = MOVEMENT_STOP;

                            break;
                        }

                        case MOTION_EVENT_SHAKE: {
                            robotState.mood = MOOD_DIZZY;
                            robotState.movement = MOVEMENT_STOP;

                            break;
                        }
                    }

                    break;
                }

                case EVENT_POWER: {
                    if(event.id == POWER_EVENT_LOW_BATTERY){
                        robotState.mood = MOOD_LOW_BATTERY;
                        robotState.movement = MOVEMENT_STOP;
                    }

                    break;
                }

                case EVENT_NETWORK:
                    // Future network-related events

                    break;

                default:
                    break;
            }
        }
    }
}